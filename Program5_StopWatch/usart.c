//------------------------------------------------------------------------------
//             __             __   ___  __
//     | |\ | /  ` |    |  | |  \ |__  /__`
//     | | \| \__, |___ \__/ |__/ |___ .__/
//
//------------------------------------------------------------------------------

#include "usart.h"
#include <avr/io.h>
#include <stdint.h>
#include <stdio.h>
#include <avr/interrupt.h>
//------------------------------------------------------------------------------
//      __   ___  ___         ___  __
//     |  \ |__  |__  | |\ | |__  /__`
//     |__/ |___ |    | | \| |___ .__/
//
//------------------------------------------------------------------------------

//------------------------------------------------------------------------------
//     ___      __   ___  __   ___  ___  __
//      |  \ / |__) |__  |  \ |__  |__  /__`
//      |   |  |    |___ |__/ |___ |    .__/
//
//------------------------------------------------------------------------------

//------------------------------------------------------------------------------
//                __          __        ___  __
//     \  /  /\  |__) |  /\  |__) |    |__  /__`
//      \/  /~~\ |  \ | /~~\ |__) |___ |___ .__/
//
//------------------------------------------------------------------------------
static uint8_t uartstring[MAX_STRING_SIZE];
volatile static uint8_t current_byte = 0;
static uint8_t busy = 0;
//------------------------------------------------------------------------------
//      __   __   __  ___  __  ___      __   ___  __
//     |__) |__) /  \  |  /  \  |  \ / |__) |__  /__`
//     |    |  \ \__/  |  \__/  |   |  |    |___ .__/
//
//------------------------------------------------------------------------------
void usart_init();
void usart_write(uint8_t data);
int usart_print (uint8_t * string);
uint8_t usart_read();
static int uart_putchar(char c, FILE *stream);
static FILE mystdout = FDEV_SETUP_STREAM(uart_putchar, NULL, _FDEV_SETUP_WRITE);
//------------------------------------------------------------------------------
//      __        __          __
//     |__) |  | |__) |    | /  `
//     |    \__/ |__) |___ | \__,
//
//------------------------------------------------------------------------------
int usart_print (uint8_t *string)
{
	uint8_t success = 0;
	
	if (!busy) {
	uint8_t *mystring = uartstring;
	// Copy string uartstring. We will print with uartstring, and the main user can update while we are printing
	while (*mystring++ = *string++);
	
	current_byte = 0;
	// Check if busy
	UDR0 = uartstring[current_byte];
	
	success = 1;
	busy = 1;
	}
	return success;
}
//==============================================================================
void usart_init()
{
	// 8-bit, 1 stop, no parity
	// 9600 baud
	// Async
	UCSR0A = 0;
	UCSR0B = (1 << RXEN0) | (1 << TXEN0) | (1<<TXCIE0) | (1<<RXCIE0);
	UCSR0C = (1 << UCSZ01) | (1 << UCSZ00);
	UBRR0H = 0;
	UBRR0L = 0x00;
	//stdout = &mystdout;
}
//==============================================================================
void usart_write(uint8_t data)
{
	// Wait for the data register to be empty
	//while( !(UCSR0A & (1<<UDRE0)))
		//; // wait for empty
		
	// Write the data
	//UDR0 = data;
}
//==============================================================================
uint8_t usart_read()
{

	return UDR0;
}

//------------------------------------------------------------------------------
//      __   __              ___  ___
//     |__) |__) | \  /  /\   |  |__
//     |    |  \ |  \/  /~~\  |  |___
//
//------------------------------------------------------------------------------
static int uart_putchar(char c, FILE *stream)
{
	usart_write(c);
	return 0;
}
//------------------------------------------------------------------------------
//      __                  __        __        __
//     /  `  /\  |    |    |__)  /\  /  ` |__/ /__`
//     \__, /~~\ |___ |___ |__) /~~\ \__, |  \ .__/
//
//------------------------------------------------------------------------------

//------------------------------------------------------------------------------
//        __   __  , __
//     | /__` |__)  /__`   
//     | .__/ |  \  .__/
//
//------------------------------------------------------------------------------
ISR(USART_TX_vect)
{
	// Move to the next byte
	current_byte++;
	
	// If non null print it.
	if(uartstring[current_byte])
	{
		UDR0 = uartstring[current_byte];
	}
	else
	{
		busy = 0;
	}
}
